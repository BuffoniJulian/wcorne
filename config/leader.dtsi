/ {
    behaviors {
        leader: leader {
            compatible = "zmk,behavior-leader-key";
            #binding-cells = <0>;
            ignore-keys = <LSHFT RSHFT>;

            email_expansion { sequence = <E M A I L>; bindings = <&email>; };
        };
    };
};
