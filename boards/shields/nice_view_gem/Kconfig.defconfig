## boards/shields/nice_view_gem/Kconfig.defconfig
```kconfig
if SHIELD_NICE_VIEW_GEM

config LV_Z_VDB_SIZE
    default 100

config LV_DPI_DEF
    default 161

config LV_Z_BITS_PER_PIXEL
    default 1

choice LV_COLOR_DEPTH
    default LV_COLOR_DEPTH_1
endchoice

choice ZMK_DISPLAY_WORK_QUEUE
    default ZMK_DISPLAY_WORK_QUEUE_DEDICATED
endchoice

choice ZMK_DISPLAY_STATUS_SCREEN
    default ZMK_DISPLAY_STATUS_SCREEN_CUSTOM
endchoice

config LV_Z_MEM_POOL_SIZE
    default 8192 if ZMK_DISPLAY_STATUS_SCREEN_CUSTOM

config ZMK_DISPLAY_STATUS_SCREEN_CUSTOM
    imply NICE_VIEW_WIDGET_STATUS

config NICE_VIEW_GEM_WPM_FIXED_RANGE
    bool "Enable fixed range for WPM gauge/chart"
    default y

config NICE_VIEW_GEM_WPM_FIXED_RANGE_MAX
    int "Fixed range maximum for WPM gauge/chart"
    default 100

config NICE_VIEW_GEM_ANIMATION
    bool "Enable animation on peripheral"
    default y

config NICE_VIEW_GEM_ANIMATION_MS
    int "Animation length in milliseconds"
    default 960

# Pomodoro Timer Configuration
config NICE_VIEW_GEM_POMODORO_WORK_DURATION
    int "Pomodoro work session duration in minutes"
    default 25

config NICE_VIEW_GEM_POMODORO_SHORT_BREAK
    int "Pomodoro short break duration in minutes"
    default 5

config NICE_VIEW_GEM_POMODORO_LONG_BREAK
    int "Pomodoro long break duration in minutes"
    default 15

config NICE_VIEW_GEM_POMODORO_LONG_BREAK_INTERVAL
    int "Number of work sessions before long break"
    default 4

config NICE_VIEW_WIDGET_STATUS
    select LV_USE_LABEL
    select LV_USE_IMG
    select LV_USE_IMAGE
    select LV_USE_CANVAS
    select LV_USE_ANIMIMG
    select LV_USE_ANIMATION
    select LV_FONT_MONTSERRAT_14
    select LV_FONT_MONTSERRAT_18

config NICE_VIEW_WIDGET_INVERTED
    bool "Invert display colors"

if !ZMK_SPLIT || ZMK_SPLIT_ROLE_CENTRAL

config NICE_VIEW_WIDGET_STATUS
    select ZMK_WPM

endif # !ZMK_SPLIT || ZMK_SPLIT_ROLE_CENTRAL

endif # SHIELD_NICE_VIEW_GEM
```

## boards/shields/nice_view_gem/dts/bindings/behaviors/zmk,behavior-anim-toggle.yaml
```yaml
description: Animation toggle behavior for nice_view_gem

compatible: "zmk,behavior-anim-toggle"

include: zero_param.yaml
```

## boards/shields/nice_view_gem/dts/bindings/behaviors/zmk,behavior-pom-add-break.yaml
```yaml
description: Pomodoro add break time behavior

compatible: "zmk,behavior-pom-add-break"

include: zero_param.yaml
```

## boards/shields/nice_view_gem/dts/bindings/behaviors/zmk,behavior-pom-add-time.yaml
```yaml
description: Pomodoro add time behavior for nice_view_gem

compatible: "zmk,behavior-pom-add-time"

include: zero_param.yaml
```

## boards/shields/nice_view_gem/dts/bindings/behaviors/zmk,behavior-pom-reset.yaml
```yaml
description: Pomodoro reset behavior for nice_view_gem

compatible: "zmk,behavior-pom-reset"

include: zero_param.yaml
```

## boards/shields/nice_view_gem/dts/bindings/behaviors/zmk,behavior-pom-start-stop.yaml
```yaml
description: Pomodoro start/stop behavior for nice_view_gem

compatible: "zmk,behavior-pom-start-stop"

include: zero_param.yaml
```

## boards/shields/nice_view_gem/dts/bindings/behaviors/zmk,behavior-pom-sub-break.yaml
```yaml
description: Pomodoro subtract break time behavior

compatible: "zmk,behavior-pom-sub-break"

include: zero_param.yaml
```

## boards/shields/nice_view_gem/dts/bindings/behaviors/zmk,behavior-pom-sub-time.yaml
```yaml
description: Pomodoro subtract time behavior for nice_view_gem

compatible: "zmk,behavior-pom-sub-time"

include: zero_param.yaml
```

## boards/shields/nice_view_gem/dts/bindings/behaviors/zmk,behavior-screen-cycle.yaml
```yaml
description: Screen cycle behavior for nice_view_gem

compatible: "zmk,behavior-screen-cycle"

include: zero_param.yaml
```

## config/west.yml
```yaml
manifest:
  defaults:
    revision: v0.3
  remotes:
    - name: zmkfirmware
      url-base: https://github.com/zmkfirmware
    - name: BuffoniJulian
      url-base: https://github.com/BuffoniJulian
    # Additional modules containing boards/shields/custom code can be listed here as well
    # See https://docs.zephyrproject.org/3.2.0/develop/west/manifest.html#projects
  
  projects:
    - name: zmk
      remote: zmkfirmware
      import: app/west.yml
    - name: zmk-leader-key
      remote: BuffoniJulian
    - name: zmk-helpers
      remote: BuffoniJulian
  self:
    path: config
```
